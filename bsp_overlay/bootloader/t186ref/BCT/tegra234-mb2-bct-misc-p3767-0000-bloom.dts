/dts-v1/;

#include "tegra234-mb2-bct-common.dtsi"

/ {
	mb2-misc {
		eeprom {
			cvb_eeprom_i2c_instance = <0x0>;
			cvb_eeprom_i2c_slave_address = <0xa0>;
			cvb_eeprom_read_size = <0x0>;
		};
	};
};
